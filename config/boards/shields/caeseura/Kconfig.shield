## config/boards/shields/caeseura/Kconfig.shield
```kconfig
config SHIELD_CAESEURA_LEFT
    def_bool $(shields_list_contains,caeseura_left)
  
config SHIELD_CAESEURA_RIGHT
    def_bool $(shields_list_contains,caeseura_right)
  
```

## zmk config/boards/shields/caeseura/Kconfig.defconfig
```kconfig
if SHIELD_CAESEURA_LEFT

# Name must be less than 16 characters long!
config ZMK_KEYBOARD_NAME
    default "Caeseura"

config ZMK_SPLIT_ROLE_CENTRAL
    default y

config ZMK_SPLIT_BLE_CENTRAL_PERIPHERALS
  default 1

config BT_MAX_CONN
  default 6

config BT_MAX_PAIRED
  default 6

endif

if SHIELD_CAESEURA_LEFT || SHIELD_CAESEURA_RIGHT

config ZMK_SPLIT
    default y

endif
```
